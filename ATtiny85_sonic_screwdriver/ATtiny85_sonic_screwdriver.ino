//MODIFIED Version of Adafruit Trinket code to give attiny85 PCM capability
//The Attiny will take a very short sound sample that will sound good if looped
//I used the sound of a sonic screwdriver to example this capability
//Crete PCM using a program such as http://thieumsweb.free.fr/english/gbacss.html, copy the code right after PROGMEM = {    and make sure that it ends with the };
//I use 8000 as my sample rate as allows the longest soundbyte to be uploaded to the chip
/*
  if you change the sample rate, alter the sample_rate value
  Otherwise the program will create a looped sound on pin 4 of the attiny85
*/
// Audio playback sketch for Adafruit Trinket.  Requires 3.3V
// Trinket board and Winbond W25Q80BV serial flash loaded with
// audio data.  PWM output on pin 4; add ~25 KHz low-pass filter
// prior to amplification.  Uses ATtiny-specific registers;
// WILL NOT RUN ON OTHER ARDUINOS.

#define ledpin 0
#define uvpin 1
#define dip0 2
#define dip1 4
//define buzpin 4

int sample_rate = 8000;
const unsigned char sample[] PROGMEM = { 32, 242, 67, 102, 211, 46, 156, 163, 54, 197, 94, 112, 183,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 201
                                       };

int fish = 0;
int sizesample = sizeof(sample);



void setup() {
  pinMode(ledpin, OUTPUT);
  pinMode(uvpin, OUTPUT);
  pinMode(btnpin, INPUT_PULLUP);

  PLLCSR |= _BV(PLLE);               // Enable 64 MHz PLL
  delayMicroseconds(100);            // Stabilize
  while (!(PLLCSR & _BV(PLOCK)));    // Wait for it...
  PLLCSR |= _BV(PCKE);               // Timer1 source = PLL

  // Set up Timer/Counter1 for PWM output
  TIMSK  = 0;                        // Timer interrupts OFF
  TCCR1  = _BV(CS10);                // 1:1 prescale
  GTCCR  = _BV(PWM1B) | _BV(COM1B1); // PWM B, clear on match
  OCR1C  = 255;                      // Full 8-bit PWM cycle
  OCR1B  = 127;                      // 50% duty at start

  pinMode(4, OUTPUT);                // Enable PWM output pin
  //pinMode(2, OUTPUT);
  //randomSeed(9);

  // Set up Timer/Counter0 for sample-playing interrupt.
  // TIMER0_OVF_vect is already in use by the Arduino runtime,
  // so TIMER0_COMPA_vect is used.  This code alters the timer
  // interval, making delay(), micros(), etc. useless (the
  // overflow interrupt is therefore disabled).

  // Timer resolution is limited to either 0.125 or 1.0 uS,
  // so it's rare that the playback rate will precisely match
  // the data, but the difference is usually imperceptible.
  TCCR0A = _BV(WGM01) | _BV(WGM00);  // Mode 7 (fast PWM)
  if (sample_rate >= 31250) {
    TCCR0B = _BV(WGM02) | _BV(CS00); // 1:1 prescale
    OCR0A  = ((F_CPU + (sample_rate / 2)) / sample_rate) - 1;
  } else {                           // Good down to about 3900 Hz
    TCCR0B = _BV(WGM02) | _BV(CS01); // 1:8 prescale
    OCR0A  = (((F_CPU / 8L) + (sample_rate / 2)) / sample_rate) - 1;
  }
  TIMSK = _BV(OCIE0A); // Enable compare match, disable overflow
}

void loop() {
  if (digitalRead(dip0) == false && digitalRead(dip1) == false) {
    //normal mode
    digitalWrite(ledpin, random(2));
    if (random(11) < 2) {
      digitalWrite(uvpin, !digitalRead(uvpin));
    }
    if (random(101) <= 5) {
      setfreq(7000 + random(1500));
    }
  }
  if (digitalRead(dip0) == false && digitalRead(dip1) == true) {
    //Torch Mode
    setfreq(7000);
    digitalWrite(ledpin, HIGH);
    digitalWrite(uvpin, LOW);
  }
  if (digitalRead(dip0) == true && digitalRead(dip1) == false) {
    //TV-B-Gone Mode
    setfreq(8000);
    digitalWrite(ledpin, random(2));
    if (random(11) < 5) {
      digitalWrite(uvpin, !digitalRead(uvpin));
    }
  }
  if (digitalRead(dip0) == true && digitalRead(dip1) == true) {
    //UV Torch Mode
    setfreq(8500);
    digitalWrite(uvpin, HIGH);
    digitalWrite(ledpin, LOW);
  }
}


void setfreq(int freq0) {
  PLLCSR |= _BV(PLLE);               // Enable 64 MHz PLL
  delayMicroseconds(100);            // Stabilize
  while (!(PLLCSR & _BV(PLOCK)));    // Wait for it...
  PLLCSR |= _BV(PCKE);               // Timer1 source = PLL

  // Set up Timer/Counter1 for PWM output
  TIMSK  = 0;                        // Timer interrupts OFF
  TCCR1  = _BV(CS10);                // 1:1 prescale
  GTCCR  = _BV(PWM1B) | _BV(COM1B1); // PWM B, clear on match
  OCR1C  = 255;                      // Full 8-bit PWM cycle
  OCR1B  = 127;                      // 50% duty at start

  pinMode(4, OUTPUT);                // Enable PWM output pin
  //pinMode(2, OUTPUT);
  //randomSeed(9);

  // Set up Timer/Counter0 for sample-playing interrupt.
  // TIMER0_OVF_vect is already in use by the Arduino runtime,
  // so TIMER0_COMPA_vect is used.  This code alters the timer
  // interval, making delay(), micros(), etc. useless (the
  // overflow interrupt is therefore disabled).

  // Timer resolution is limited to either 0.125 or 1.0 uS,
  // so it's rare that the playback rate will precisely match
  // the data, but the difference is usually imperceptible.
  TCCR0A = _BV(WGM01) | _BV(WGM00);  // Mode 7 (fast PWM)
  sample_rate = freq0;
  if (sample_rate >= 31250) {
    TCCR0B = _BV(WGM02) | _BV(CS00); // 1:1 prescale
    OCR0A  = ((F_CPU + (sample_rate / 2)) / sample_rate) - 1;
  } else {                           // Good down to about 3900 Hz
    TCCR0B = _BV(WGM02) | _BV(CS01); // 1:8 prescale
    OCR0A  = (((F_CPU / 8L) + (sample_rate / 2)) / sample_rate) - 1;
  }
  TIMSK = _BV(OCIE0A); // Enable compare match, disable overflow
}


ISR(TIMER0_COMPA_vect) {
  OCR1B = pgm_read_byte(&sample[fish]);      // Read flash, write PWM reg.
  fish ++;
  if (fish >= sizesample) {
    fish = 0;
  }
}

